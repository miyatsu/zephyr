## boards/arm/nrf51_polyu/Kconfig.board
```kconfig
# Kconfig - nRF51 POLYU board configuration
#
# Copyright (c) 2017 Trylong Limited.
#
# SPDX-License-Identifier: Apache-2.0

config BOARD_NRF51_POLYU
	bool "nRF51 POLYU"
	depends on SOC_NRF51822_QFAA
```

## boards/arm/nrf51_polyu/Kconfig.defconfig
```kconfig
# Kconfig - nRF51 POLYU board configuration
#
# Copyright (c) 2017 Trylong Limited.
#
# SPDX-License-Identifier: Apache-2.0

if BOARD_NRF51_POLYU

config BOARD
	default nrf51_polyu

if GPIO_NRF5

config GPIO_NRF5_P0
	default y

endif # GPIO_NRF5

if UART_NRF5

config UART_NRF5_GPIO_TX_PIN
	default 21

config UART_NRF5_GPIO_RX_PIN
	default 23

config UART_NRF5_GPIO_RTS_PIN
	default 8

config UART_NRF5_GPIO_CTS_PIN
	default 10

endif # UART_NRF5

endif # BOARD_NRF51_POLYU
```

## boards/arm/stm32f4_explo/Kconfig.board
```kconfig
# Kconfig - STM32F4EXPLORER board configuration
#
# Copyright (c) 2017 Ding Tao <miyatsu@qq.com>
#
# SPDX-License-Identifier: Apache-2.0
#

config BOARD_STM32F4_EXPLO
	bool "STM32F4EXPLORER Development Board"
	depends on SOC_STM32F407XG
```

## boards/arm/stm32f4_explo/Kconfig.defconfig
```kconfig
# Kconfig - STM32F4EXPLORER board configuration
#
# Copyright (c) 2017 Ding Tao <miyatsu@qq.com>
#
# SPDX-License-Identifier: Apache-2.0
#

if BOARD_STM32F4_EXPLO

config BOARD
	default stm32f4_explo

if UART_CONSOLE

config UART_STM32_PORT_1
	default y

endif # UART_CONSOLE

endif # BOARD_STM32F4_EXPLO
```

## subsys/lorawan/radio/Kconfig.sx1276
```kconfig
# Kconfig - Semtech sx1276 radio chip configuration
#
# Copyright (c) 2018 Ding Tao
#
# SPDX-License-Identifier: Apache-2.0
#

menu "SX1276 Configuration"
	visible if SX1276

config SX1276_SPI_DEV_NAME
	string "SPI device name"
	default "SPI_1"

config SX1276_RESET_DEV_NAME
	string "SX1276 Reset GPIO device name"
	default "GPIOA"

config SX1276_RESET_PIN_NUM
	int "SX1276 Reset GPIO pin number"
	default 12

config SX1276_DIO0_DEV_NAME
	string "DIO0 GPIO device name"
	default "GPIOA"

config SX1276_DIO0_PIN_NUM
	int "DIO0 GPIO pin number"
	default 11

config SX1276_DIO1_DEV_NAME
	string "DIO1 GPIO device name"
	default "GPIOA"

config SX1276_DIO1_PIN_NUM
	int "DIO1 GPIO pin number"
	default 8

config SX1276_DIO2_DEV_NAME
	string "DIO2 GPIO device name"
	default "GPIOB"

config SX1276_DIO2_PIN_NUM
	int "DIO2 GPIO pin number"
	default 15

config SX1276_DIO3_DEV_NAME
	string "DIO3 GPIO device name"
	default "GPIOB"

config SX1276_DIO3_PIN_NUM
	int "DIO3 GPIO pin number"
	default 14

config SX1276_DIO4_DEV_NAME
	string "DIO4 GPIO device name"
	default "GPIOB"

config SX1276_DIO4_PIN_NUM
	int "DIO4 GPIO pin number"
	default 13

config SX1276_DIO5_DEV_NAME
	string "DIO5 GPIO device name"
	default "GPIOB"

config SX1276_DIO5_PIN_NUM
	int "DIO5 GPIO pin number"
	default 12

endmenu
```
